## kernel/drivers/nvecUpdate/Kconfig
```kconfig
config NVEC_UPDATE
	tristate "LED Class Support"
	default y
	help
	  This is NV EC update driver for nvEC_UpdateTool.
```

## kernel/drivers/recovery/Kconfig
```kconfig
config QCI_RECOVERY
	tristate "recovery Class Support"
	help
	  This is for QCI recovery mode.
```
